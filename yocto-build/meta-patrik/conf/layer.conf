## yocto-build/meta-patrik/conf/layer.conf
```bitbake
# We have a conf and classes directory, add to BBPATH
BBPATH .= ":${LAYERDIR}"

# We have recipes-* directories, add to BBFILES
BBFILES += "${LAYERDIR}/recipes-*/*/*.bb \
            ${LAYERDIR}/recipes-*/*/*.bbappend"

BBFILE_COLLECTIONS += "meta-patrik"
BBFILE_PATTERN_meta-patrik = "^${LAYERDIR}/"
BBFILE_PRIORITY_meta-patrik = "6"

LAYERDEPENDS_meta-patrik = "core"
LAYERSERIES_COMPAT_meta-patrik = "kirkstone langdale"
```
